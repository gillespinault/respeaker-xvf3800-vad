## sdkconfig.defaults
```kconfig
# ReSpeaker XVF3800 VAD - SDK Configuration Defaults
# Target: ESP32-S3

# CPU Frequency
CONFIG_ESP_DEFAULT_CPU_FREQ_MHZ_240=y

# Flash size (8MB on XIAO ESP32-S3)
CONFIG_ESPTOOLPY_FLASHSIZE_8MB=y

# Partition table
CONFIG_PARTITION_TABLE_CUSTOM=y
CONFIG_PARTITION_TABLE_CUSTOM_FILENAME="partitions.csv"

# PSRAM (enable for ESP-SR models)
CONFIG_SPIRAM=y
CONFIG_SPIRAM_MODE_OCT=y
CONFIG_SPIRAM_SPEED_80M=y

# ESP-SR Configuration
# Disable Multinet (command recognition) - we only want VAD
CONFIG_SR_MN_EN_NONE=y

# Use AFE with VAD
CONFIG_USE_AFE=y
CONFIG_AFE_INTERFACE_V1=y

# FreeRTOS
CONFIG_FREERTOS_HZ=1000

# Log level
CONFIG_LOG_DEFAULT_LEVEL_INFO=y

# I2S
CONFIG_I2S_ENABLE_DEBUG_LOG=n
```
